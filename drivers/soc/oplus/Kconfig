## drivers/soc/oplus/Kconfig
```kconfig
#ifdef OPLUS_FEATURE_MM_FEEDBACK
source "drivers/soc/oplus/multimedia/Kconfig"
#endif /* OPLUS_FEATURE_MM_FEEDBACK */

#ifdef OPLUS_FEATURE_BOOT
source "drivers/soc/oplus/boot/Kconfig"
#endif /* OPLUS_FEATURE_BOOT */

#ifdef OPLUS_FEATURE_TP_BASIC
source "drivers/soc/oplus/device_info/Kconfig"
#endif /* OPLUS_FEATURE_TP_BASIC */

#ifdef OPLUS_UFS_DRIVER
source "drivers/soc/oplus/storage/common/ufs_oplus_dbg/Kconfig"
#endif

#ifdef OPLUS_FEATURE_DFT
source "drivers/soc/oplus/dft/Kconfig"
#endif /* OPLUS_FEATURE_DFT */

#ifdef OPLUS_FEATURE_MDMFEATURE
source "drivers/soc/oplus/mdmfeature/Kconfig"
#endif /*OPLUS_FEATURE_MDMFEATURE*/
```
